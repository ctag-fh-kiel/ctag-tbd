## main/Kconfig.projbuild
```kconfig
menu "CTAG TBD Configuration"

    menu "TBD Hardware Configuration"
        config TBD_USE_SD_CARD
            bool "Enable SD Card Support"
            default y
            help
                Enable SD card as the storage backend for presets, WebUI, and samples.
                When disabled, the system uses LittleFS flash partitions for presets/WebUI
                and a flash partition for the sample ROM (.tbd binary format).
                Disable this for boards without an SD card socket (Config A, Config B).

        config TBD_USE_RP2350
            bool "Enable RP2350 Sequencer Bridge"
            default y
            help
                Enable the RP2350 SPI bridge for hardware sequencer, OLED display,
                and MIDI routing via the Pico subsystem.
                When disabled, MIDI is received directly via ESP32-P4 native USB-MIDI
                (TinyUSB), and SPI2/SPI3 buses are not initialized (freeing 10 GPIO pins).
                Disable this for boards without an RP2350 (Config A, Config C).
    endmenu

    config ABLETON_LINK
        bool "Enable Ableton Link Support"
        default y
        help
            Enable Ableton Link support for tempo synchronization over network.

    config ABLETON_LINK_DEBUG
        bool "Enable Ableton Link Debug Output"
        default n
        depends on ABLETON_LINK
        help
            Enable debug output for Ableton Link.

    menu "Sample ROM Settings"
        config MAX_ALLOC_BYTES_PSRAM_SAMPLE_DATA
            int "Maximum PSRAM Allocation Size Sample Data"
            default 29360128 # 28MB
            range 8388608 31457280 # 8MB to 30MB
            help
                Define maximum PSRAM allocation size for sample data in ctagSampleRom.
                Files from sd-card will be stored here.
                All mem allocated here is not available for other uses, when ctagSampleRom is instantiated.

        config MAX_SAMPLES_IN_SAMPLE_ROM
            int "Maximum Number of Samples in Sample ROM"
            default 128
            range 32 1024 # max 32*32 addressable in web ui
            help
                Define maximum number of samples in sample rom.
                This limits the number of sample slots available in ctagSampleRom.
                It is samples, i.e. files from sd-card, that are loaded into sample rom, not bytes.
    endmenu

    config SP_FIXED_MEM_ALLOC_SZ
        int "Sound Processor Fixed Memory Alloc Size"
        default 300000
        range 113944 380000
        help
            Define sound processor fixed memory size allocated at startup.
            Sound processors are allocated from this memory pool.

    menu "Optional Tasks"
        config TASK_REST_SERVER
            bool "Start REST Server Task"
            default y
            help
                Enable REST server task for handling HTTP requests offering TBD web-ui.

        config TASK_RGB_INDICATOR_LED
            bool "Enable RGB Indicator LED Task"
            default n
            help
                Drives indicator RGB LED to show system status.

    endmenu

    menu "Optimizations"
        config ASSEMBLY_OPT_AUDIO_BUFFER_CODEC
            bool "Enable Assembly Optimizations for Audio Buffer Codec"
            default y
            help
                Enable assembly optimizations for audio buffer codec processing to improve performance.
                P4 F-extension, loop unrolling, hardware loop and other optimizations are used.
                Works only for 32 samples per buffer configuration. Small improvement.

        config SD_DDR_50MHZ_MODE
            bool "Enable SD Card DDR 50MHz Mode"
            default n
            help
                Enable DDR mode at 50MHz for SD card interface to improve data transfer rates.
                Requires compatible SD card and hardware support.
    endmenu

endmenu
```

## sdkconfig.defaults.tbd-rp2350-only
```kconfig
# Hardware overlay: TBD + RP2350 (Config B)
# RP2350 bridge enabled, no SD card — flash-only storage
# Usage: idf.py -DSDKCONFIG_DEFAULTS="sdkconfig.defaults;sdkconfig.defaults.tbd-rp2350-only" build
CONFIG_TBD_USE_SD_CARD=n
CONFIG_TBD_USE_RP2350=y
CONFIG_PARTITION_TABLE_CUSTOM_FILENAME="partitions_no_sd.csv"
CONFIG_PARTITION_TABLE_FILENAME="partitions_no_sd.csv"
```

## sdkconfig.defaults.tbd-sd-only
```kconfig
# Hardware overlay: TBD + SD (Config C)
# SD card enabled, no RP2350 — USB-MIDI, no sequencer
# Usage: idf.py -DSDKCONFIG_DEFAULTS="sdkconfig.defaults;sdkconfig.defaults.tbd-sd-only" build
CONFIG_TBD_USE_SD_CARD=y
CONFIG_TBD_USE_RP2350=n
```

## sdkconfig.defaults.tbd-simple
```kconfig
# Hardware overlay: TBD Simple (Config A)
# No SD card, no RP2350 — flash-only storage, USB-MIDI
# Usage: idf.py -DSDKCONFIG_DEFAULTS="sdkconfig.defaults;sdkconfig.defaults.tbd-simple" build
CONFIG_TBD_USE_SD_CARD=n
CONFIG_TBD_USE_RP2350=n
CONFIG_PARTITION_TABLE_CUSTOM_FILENAME="partitions_no_sd.csv"
CONFIG_PARTITION_TABLE_FILENAME="partitions_no_sd.csv"
```

## tbd/tbd_sounds/Kconfig.projbuild
```kconfig
menu "CTAG TBD Plugins"
    

    config TBD_PLUGINS_E_CHORUS_ENABLED
        bool "enable e chorus"
        default y
        help 
            add to rom or not

    config TBD_PLUGINS_WT_OSC_ENABLED
        bool "enable wt osc"
        default y
        help 
            add to rom or not

    config TBD_PLUGINS_BJORKLUND_ENABLED
        bool "enable bjorklund"
        default y
        help 
            add to rom or not

    config TBD_PLUGINS_B_BEATS_ENABLED
        bool "enable b beats"
        default y
        help 
            add to rom or not

    config TBD_PLUGINS_MI_VERB_ENABLED
        bool "enable mi verb"
        default y
        help 
            add to rom or not

    config TBD_PLUGINS_KARPUSKL_ENABLED
        bool "enable karpuskl"
        default y
        help 
            add to rom or not

    config TBD_PLUGINS_MI_ENSEMBLE_ENABLED
        bool "enable mi ensemble"
        default y
        help 
            add to rom or not

    config TBD_PLUGINS_STRAMP_DLY_ENABLED
        bool "enable stramp dly"
        default y
        help 
            add to rom or not

    config TBD_PLUGINS_REC_N_PLAY_ENABLED
        bool "enable rec n play"
        default y
        help 
            add to rom or not

    config TBD_PLUGINS_MI_DIFU_ENABLED
        bool "enable mi difu"
        default y
        help 
            add to rom or not

    config TBD_PLUGINS_TB_DAITS_ENABLED
        bool "enable tb daits"
        default y
        help 
            add to rom or not

    config TBD_PLUGINS_MAC_OSC_ENABLED
        bool "enable mac osc"
        default y
        help 
            add to rom or not

    config TBD_PLUGINS_FB_DLY_LINE_ENABLED
        bool "enable fb dly line"
        default y
        help 
            add to rom or not

    config TBD_PLUGINS_MISVF_ENABLED
        bool "enable MISVF"
        default y
        help 
            add to rom or not

    config TBD_PLUGINS_M_SXX_NOISE_ENABLED
        bool "enable m sxx noise"
        default y
        help 
            add to rom or not

    config TBD_PLUGINS_G_VERB_ENABLED
        bool "enable g verb"
        default y
        help 
            add to rom or not

    config TBD_PLUGINS_WT_OSC_DUO_ENABLED
        bool "enable wt osc duo"
        default y
        help 
            add to rom or not

    config TBD_PLUGINS_ROMPLER_ENABLED
        bool "enable rompler"
        default y
        help 
            add to rom or not

    config TBD_PLUGINS_FORMANTOR_ENABLED
        bool "enable formantor"
        default y
        help 
            add to rom or not

    config TBD_PLUGINS_VCTR_SNT_ENABLED
        bool "enable vctr snt"
        default y
        help 
            add to rom or not

    config TBD_PLUGINS_BCSR_ENABLED
        bool "enable BCSR"
        default y
        help 
            add to rom or not

    config TBD_PLUGINS_TB_DINGS_ENABLED
        bool "enable tb dings"
        default y
        help 
            add to rom or not

    config TBD_PLUGINS_F_VERB_ENABLED
        bool "enable f verb"
        default y
        help 
            add to rom or not

    config TBD_PLUGINS_DUST_ENABLED
        bool "enable dust"
        default y
        help 
            add to rom or not

    config TBD_PLUGINS_TB_DEEP_ENABLED
        bool "enable tb deep"
        default y
        help 
            add to rom or not

    config TBD_PLUGINS_SUB_SYNTH_ENABLED
        bool "enable sub synth"
        default y
        help 
            add to rom or not

    config TBD_PLUGINS_DRUM_RACK_ENABLED
        bool "enable drum rack"
        default y
        help 
            add to rom or not

    config TBD_PLUGINS_SINE_SRC_ENABLED
        bool "enable sine src"
        default y
        help 
            add to rom or not

    config TBD_PLUGINS_MI_CHORUS_ENABLED
        bool "enable mi chorus"
        default y
        help 
            add to rom or not

    config TBD_PLUGINS_VOID_ENABLED
        bool "enable void"
        default y
        help 
            add to rom or not

    config TBD_PLUGINS_GD_VERB2_ENABLED
        bool "enable gd verb2"
        default y
        help 
            add to rom or not

    config TBD_PLUGINS_HIHAT1_ENABLED
        bool "enable hihat1"
        default y
        help 
            add to rom or not

    config TBD_PLUGINS_GD_VERB_ENABLED
        bool "enable gd verb"
        default y
        help 
            add to rom or not

    config TBD_PLUGINS_TEST_PROCESSOR_ENABLED
        bool "enable test processor"
        default y
        help 
            add to rom or not

    config TBD_PLUGINS_T_DELAY_ENABLED
        bool "enable t delay"
        default y
        help 
            add to rom or not

    config TBD_PLUGINS_C_DELAY_ENABLED
        bool "enable c delay"
        default y
        help 
            add to rom or not

    config TBD_PLUGINS_CLAUDE_ENABLED
        bool "enable claude"
        default y
        help 
            add to rom or not

    config TBD_PLUGINS_TBD03_ENABLED
        bool "enable TBD03"
        default y
        help 
            add to rom or not

    config TBD_PLUGINS_POLY_PAD_ENABLED
        bool "enable poly pad"
        default y
        help 
            add to rom or not

    config TBD_PLUGINS_FREAKWAVES_ENABLED
        bool "enable freakwaves"
        default y
        help 
            add to rom or not

    config TBD_PLUGINS_TALKBOX_ENABLED
        bool "enable talkbox"
        default y
        help 
            add to rom or not

    config TBD_PLUGINS_P_NOISE_ENABLED
        bool "enable p noise"
        default y
        help 
            add to rom or not

    config TBD_PLUGINS_C_STRIP_M_ENABLED
        bool "enable c strip m"
        default y
        help 
            add to rom or not

    config TBD_PLUGINS_MIP_SHFT_ENABLED
        bool "enable mip shft"
        default y
        help 
            add to rom or not

    config TBD_PLUGINS_D_LOOP_ENABLED
        bool "enable d loop"
        default y
        help 
            add to rom or not

    config TBD_PLUGINS_MAC_OSC_DUO_ENABLED
        bool "enable mac osc duo"
        default y
        help 
            add to rom or not

    config TBD_PLUGINS_ANTIQUE_ENABLED
        bool "enable antique"
        default y
        help 
            add to rom or not

    config TBD_PLUGINS_EVERY_TRIM_ENABLED
        bool "enable every trim"
        default y
        help 
            add to rom or not

    config TBD_PLUGINS_SUBBOTNIK_ENABLED
        bool "enable subbotnik"
        default y
        help 
            add to rom or not

    config TBD_PLUGINS_SIMPLE_VCA_ENABLED
        bool "enable simple vca"
        default y
        help 
            add to rom or not

    config TBD_PLUGINS_MOOG_FILT_ENABLED
        bool "enable moog filt"
        default y
        help 
            add to rom or not

    config TBD_PLUGINS_SPACE_FX_ENABLED
        bool "enable space fx"
        default y
        help 
            add to rom or not

    config TBD_PLUGINS_RETROACTOR_ENABLED
        bool "enable retroactor"
        default y
        help 
            add to rom or not

    config TBD_PLUGINS_AP_CPP_ENABLED
        bool "enable ap cpp"
        default y
        help 
            add to rom or not

    config TBD_PLUGINS_C_STRIP_ENABLED
        bool "enable c strip"
        default y
        help 
            add to rom or not

    config TBD_PLUGINS_MI_VERB2_ENABLED
        bool "enable mi verb2"
        default y
        help 
            add to rom or not

    
endmenu
```

## tools/tbd_tools/preprocessor/templates/Kconfig.projbuild
```kconfig
menu "CTAG TBD Plugins"
    
    config TBD_PLUGINS_TEST_PLUGIN_1_ENABLED
        bool "enable TestPlugin1"
        default 1
        help "bar add to rom or not"

    config TBD_PLUGINS_TEST_PLUGIN_2_ENABLED
        bool "enable TestPlugin2"
        default 1
        help "foo add to rom or not"
    
endmenu
```
